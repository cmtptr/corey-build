## conf/layer.conf
```bitbake
# We have a conf and classes directory, add to BBPATH
BBPATH .= ":${LAYERDIR}"

# We have recipes-* directories, add to BBFILES
BBFILES += "${LAYERDIR}/recipes-*/*/*.bb \
            ${LAYERDIR}/recipes-*/*/*.bbappend"

BBFILE_COLLECTIONS += "corey"
BBFILE_PATTERN_corey = "^${LAYERDIR}/"
BBFILE_PRIORITY_corey = "50"

LAYERDEPENDS_corey = "core"
LAYERSERIES_COMPAT_corey = "honister"
```

## conf/machine/vpk120-versal.conf
```bitbake
#@TYPE: Machine
#@NAME: vpk120
#@DESCRIPTION: Generated vpk120 machine

#### Preamble
MACHINEOVERRIDES =. "${@['', 'vpk120:']['vpk120' != '${MACHINE}']}"
#### Regular settings follow

unset BOARD
unset BOARD_VARIANT

DEFAULTTUNE ?= "cortexa72-cortexa53"
SOC_VARIANT ?= "prime"

require conf/machine/versal-generic.conf

YAML_DT_BOARD_FLAGS:vpk120 ?= "{BOARD versal-vpk120-revb}"

# This machine has a QEMU model, runqemu setup:
QB_KERNEL_CMDLINE_APPEND = "${@qemu_default_serial(d)}"
QB_OPT_APPEND += "-serial mon:stdio -display none"

#### No additional settings should be after the Postamble
#### Postamble
PACKAGE_EXTRA_ARCHS:append = "${@['', ' vpk120_versal']['vpk120-versal' != "${MACHINE}"]}"
```
